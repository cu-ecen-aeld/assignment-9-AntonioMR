## base_external/package/aesdchar/Config.in
```kconfig
config BR2_PACKAGE_AESDCHAR
	bool "aesdchar"
    depends on BR2_LINUX_KERNEL
	help
	  Includes the building and installing the aesdchar dinamyc circular buffer driver based in lists
	  into the root filesystem
```

## base_external/package/ldd/Config.in
```kconfig
config BR2_PACKAGE_LDD
	bool "ldd"
    depends on BR2_LINUX_KERNEL
	help
	  Includes the building and installing the misc-modules and scull components 
	  into the root filesystem
```
